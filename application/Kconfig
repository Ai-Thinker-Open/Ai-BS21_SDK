## application/Kconfig
```kconfig
#===============================================================================
# @brief    Kconfig file.
# Copyright (c) @CompanyNameMagicTag 2023-2023. All rights reserved.
#===============================================================================

config USER_FIRMWARE_VERSION
    string
    prompt "User Defined Firmware Version"
    default "0.0.0.1"
    help
        This is a user defined firmware version string.
        The string must not exceed 40 characters.

config SYSTEM_CONTROL_ENABLE
    bool
    prompt "Enable system control."
    default n
    help
        This option means support system control config.

if SYSTEM_CONTROL_ENABLE
config POWER_SUPPLY_BY_LDO
    bool
    prompt "Power supply by ldo."
    default n
    depends on SYSTEM_CONTROL_ENABLE
    help
        This option means Power supply by ldo.

config REDUCE_PERP_LS_FREQ
    bool
    prompt "Reduce the frequency of low-speed peripherals."
    default n
    depends on SYSTEM_CONTROL_ENABLE
    help
        This option means reduce the frequency of low-speed peripherals.

config REDUCE_FREQ_DURING_WFI
    bool
    prompt "Reduce frequency during wfi."
    default n
    depends on SYSTEM_CONTROL_ENABLE
    help
        This option means reduce frequency during wfi.

config ULTRA_DEEP_SLEEP_ENABLE
    bool
    prompt "Enable ultra-deep sleep."
    default n
    depends on SYSTEM_CONTROL_ENABLE
    help
        This option means support ultra-deep sleep.

config PM_XO_FAST_START_ENABLE
    bool
    prompt "Enable xo fast start."
    default n
    depends on SYSTEM_CONTROL_ENABLE
    help
        This option means support xo fast start.

config XO_32K_ENABLE
    bool
    prompt "Enable the xo 32k clock."
    default n
    depends on SYSTEM_CONTROL_ENABLE
    help
        This option means enable the xo 32k clock.

config SUPPORT_CLOSE_ULP_WDT_DURING_SLP
    bool
    prompt "Support close ulp-wdt during sleep."
    default n
    depends on SYSTEM_CONTROL_ENABLE
    help
        This option means support close ulp-wdt during sleep.

endif

config SAMPLE_ENABLE
    bool
    prompt "Enable Sample."
    default n
    help
        This option means support Samples.

if SAMPLE_ENABLE
osource "application/samples/Kconfig"
endif
```

## application/samples/peripheral/blinky/Kconfig
```kconfig
#===============================================================================
# @brief    Kconfig file.
# Copyright (c) @CompanyNameMagicTag 2023-2023. All rights reserved.
#===============================================================================

config BLINKY_PIN
    int
    prompt "Choose BLINKY_PIN pin."
    depends on SAMPLE_SUPPORT_BLINKY
    default 31

config BLINKY_DURATION_MS
    int
    prompt "Duration of blinky in MS."
    default 500
```

## application/samples/peripheral/button/Kconfig
```kconfig
#===============================================================================
# @brief    Kconfig file.
# Copyright (c) @CompanyNameMagicTag 2023-2023. All rights reserved.
#===============================================================================

config BUTTON_PIN
    int
    prompt "Choose BLINKY_PIN pin."
    depends on SAMPLE_SUPPORT_BUTTON
    default 2
```

## application/samples/peripheral/i2c/Kconfig
```kconfig
#===============================================================================
# @brief    Kconfig file.
# Copyright (c) @CompanyNameMagicTag 2023-2023. All rights reserved.
#===============================================================================
config SAMPLE_SUPPORT_I2C_MASTER
    bool
    prompt "Support I2C Master Sample."
    default n
    depends on SAMPLE_SUPPORT_I2C
    help
        This option means support I2C Master Sample.

config I2C_MASTER_BUS_ID
    int
    prompt "Choose I2C master bus id."
    depends on SAMPLE_SUPPORT_I2C_MASTER
    default 0

config I2C_SCL_MASTER_PIN
    int
    prompt "Choose I2C SCL master pin."
    depends on SAMPLE_SUPPORT_I2C_MASTER
    default 13

config I2C_SDA_MASTER_PIN
    int
    prompt "Choose I2C SDA master pin."
    depends on SAMPLE_SUPPORT_I2C_MASTER
    default 14


config SAMPLE_SUPPORT_I2C_SLAVE
    bool
    prompt "Support I2C Slave Sample."
    default n
    depends on SAMPLE_SUPPORT_I2C
    help
        This option means support I2C Slave Sample.

config I2C_SLAVE_BUS_ID
    int
    prompt "Choose I2C slave bus id."
    depends on SAMPLE_SUPPORT_I2C_SLAVE
    default 0

config I2C_SCL_SLAVE_PIN
    int
    prompt "Choose I2C SCL slave pin."
    depends on SAMPLE_SUPPORT_I2C_SLAVE
    default 13

config I2C_SDA_SLAVE_PIN
    int
    prompt "Choose I2C SDA slave pin."
    depends on SAMPLE_SUPPORT_I2C_SLAVE
    default 14

config I2C_TRANSFER_LEN
    int
    prompt "Choose I2C transfer length."
    depends on SAMPLE_SUPPORT_I2C
    default 8
```

## application/samples/peripheral/i2s/Kconfig
```kconfig
#===============================================================================
# @brief    Kconfig file.
# Copyright (c) @CompanyNameMagicTag 2023-2023. All rights reserved.
#===============================================================================
config SAMPLE_SUPPORT_I2S_MASTER
    bool
    prompt "Support I2S Master Sample."
    default n
    depends on SAMPLE_SUPPORT_I2S
    help
        This option means support I2S Master Sample.

config I2S_MASTER_BUS_ID
    int
    prompt "Choose I2S master bus id."
    depends on SAMPLE_SUPPORT_I2S_MASTER
    default 0

config I2S_CLK_MASTER_PIN
    int
    prompt "Choose I2S CLK master pin."
    depends on SAMPLE_SUPPORT_I2S_MASTER
    default 13

config I2S_WS_MASTER_PIN
    int
    prompt "Choose I2S WS master pin."
    depends on SAMPLE_SUPPORT_I2S_MASTER
    default 14

config I2S_DO_MASTER_PIN
    int
    prompt "Choose I2S DO master pin."
    depends on SAMPLE_SUPPORT_I2S_MASTER
    default 15

config I2S_DI_MASTER_PIN
    int
    prompt "Choose I2S DI master pin."
    depends on SAMPLE_SUPPORT_I2S_MASTER
    default 16

config SAMPLE_SUPPORT_I2S_SLAVE
    bool
    prompt "Support I2S Slave Sample."
    default n
    depends on SAMPLE_SUPPORT_I2S
    help
        This option means support I2S Slave Sample.

config I2S_SLAVE_BUS_ID
    int
    prompt "Choose I2S slave bus id."
    depends on SAMPLE_SUPPORT_I2S_SLAVE
    default 0

config I2S_CLK_SLAVE_PIN
    int
    prompt "Choose I2S CLK slave pin."
    depends on SAMPLE_SUPPORT_I2S_SLAVE
    default 13

config I2S_WS_SLAVE_PIN
    int
    prompt "Choose I2S WS slave pin."
    depends on SAMPLE_SUPPORT_I2S_SLAVE
    default 14

config I2S_DO_SLAVE_PIN
    int
    prompt "Choose I2S DO slave pin."
    depends on SAMPLE_SUPPORT_I2S_SLAVE
    default 15

config I2S_DI_SLAVE_PIN
    int
    prompt "Choose I2S DI slave pin."
    depends on SAMPLE_SUPPORT_I2S_SLAVE
    default 16

config I2S_TRANSFER_LEN
    int
    prompt "Choose I2S transfer length."
    depends on SAMPLE_SUPPORT_I2S
    default 32
```

## application/samples/peripheral/qdec/Kconfig
```kconfig
#===============================================================================
# @brief    Kconfig file.
# Copyright (c) @CompanyNameMagicTag 2023-2023. All rights reserved.
#===============================================================================
config QDEC_A_PIN
    int
    prompt "Choose QDEC_A pin."
    depends on SAMPLE_SUPPORT_QDEC
    default 27

config QDEC_B_PIN
    int
    prompt "Choose QDEC_B pin."
    depends on SAMPLE_SUPPORT_QDEC
    default 28
```

## drivers/Kconfig
```kconfig
#===============================================================================
# @brief    Kconfig file.
# Copyright (c) @CompanyNameMagicTag 2022-2022. All rights reserved.
#===============================================================================
menu "Boards"
    comment "Config the drivers of boards."
    osource "drivers/boards/Kconfig"
endmenu

menu "Chips"
    comment "Config the drivers of chips."
    osource "drivers/chips/Kconfig"
endmenu

menu "Drivers"
    comment "Config the drivers."
    osource "drivers/drivers/Kconfig"
endmenu
```

## drivers/chips/Kconfig
```kconfig
#===============================================================================
# @brief    Kconfig file.
# Copyright (c) @CompanyNameMagicTag 2022-2022. All rights reserved.
#===============================================================================

choice
    prompt "Choose Chip"
    default CHIP_BS2X
config CHIP_WS53
    bool "ws53"

config CHIP_WS63
    bool "ws63"

config CHIP_BS2X
    bool "bs2x"
endchoice

if CHIP_WS53
menu "Chip Configurations for ws53"
    comment "Config ws53"
    osource "drivers/chips/ws53/Kconfig"
endmenu
endif

if CHIP_WS63
menu "Chip Configurations for ws63"
    comment "Config ws63"
    osource "drivers/chips/ws63/Kconfig"
endmenu
endif

if CHIP_BS2X
menu "Chip Configurations for bs2x"
    comment "bs2x chipset resource config"
    osource "drivers/chips/bs2x/Kconfig"
endmenu
endif
```

## drivers/chips/bs2x/Kconfig
```kconfig
#===============================================================================
# @brief    Kconfig file.
# Copyright (c) @CompanyNameMagicTag 2022-2022. All rights reserved.
#===============================================================================
config I2C_BUS_MAX_NUM
    int
    prompt "I2C Max Bus num, the BS2x chip supports a maximum of 2 buses."
    range 1 2
    default 1
    depends on DRIVER_SUPPORT_I2C

config SPI_BUS_MAX_NUM
    int
    prompt "SPI Max Bus num, the BS2x chip supports a maximum of 3 buses."
    range 1 3
    default 1
    depends on DRIVER_SUPPORT_SPI

config SUPPORT_LOG_THREAD
    bool
    prompt "CREATE LOG MAIN THREAD."
    default y
```

## drivers/drivers/driver/cpu_trace/Kconfig
```kconfig
#===============================================================================
# @brief    Kconfig file.
# Copyright (c) @CompanyNameMagicTag 2023-2023. All rights reserved.
#===============================================================================
config CPU_TRACE_SUPPORT_LPM
    bool
    prompt "CPUTRACE Support low power mode, enter sleep."
    default n
    depends on DRIVER_SUPPORT_CPUTRACE
```

## drivers/drivers/driver/flash/Kconfig
```kconfig
#===============================================================================
# @brief    Kconfig file.
# Copyright (c) @CompanyNameMagicTag 2022-2022. All rights reserved.
#===============================================================================

config FLASH_SUPPORT_XIP
    bool
    prompt "Flash support xip mode"
    default y
    depends on DRIVER_SUPPORT_FLASH

config SPI_WAIT_FIFO_LONG_TIMEOUT
    hex
    prompt "Max time of SPI waiting"
    default 0xFFFFFFFF
    depends on DRIVER_SUPPORT_FLASH

config SPI_TRAN_MAX_TIMEOUT
    hex
    prompt "Max time of SPI transfer"
    default 0xFFFFFFFF
    depends on DRIVER_SUPPORT_FLASH

config SPI_WAIT_READ_TIMEOUT
    hex
    prompt "Max time of SPI reading"
    default 0xFFFFFFFF
    depends on DRIVER_SUPPORT_FLASH

config FLASH_POWER_ON_TIMEOUT
    hex
    prompt "Max time of power on"
    default 0xFF
    depends on DRIVER_SUPPORT_FLASH

config SPI_RX_FIFO_THRESHOLD
    hex
    prompt "FIFO threshold of SPI RX"
    default 0xC
    depends on DRIVER_SUPPORT_FLASH

config SPI_TX_FIFO_THRESHOLD
    hex
    prompt "FIFO threshold of SPI TX"
    default 0xC
    depends on DRIVER_SUPPORT_FLASH

config FLASH_ALREADY_START
    bool
    prompt "Flash has been started in another binary"
    default y
    depends on DRIVER_SUPPORT_FLASH

config FLASH_SUPPORT_LPC
    bool
    prompt "Flash Support low power control, control power and clock"
    default n
    depends on DRIVER_SUPPORT_FLASH

config FLASH_SUPPORT_SPI_SINGLE_LINE_MODE
    bool
    prompt "Flash support spi single line mode"
    default n
    depends on DRIVER_SUPPORT_FLASH

config FLASH_USE_SPI_SINGLE_LINE_MODE_ONLY
    bool
    prompt "Flash use spi single-line mode only"
    default n
    depends on DRIVER_SUPPORT_FLASH

config FLASH_USE_CUSTOMIZED_DEVICE_INFO
    bool
    prompt "Flash use custom device information, which is defined in the porting"
    default n
    depends on DRIVER_SUPPORT_FLASH
```

## drivers/drivers/driver/ir/Kconfig
```kconfig
#===============================================================================
# @brief    Kconfig file.
# Copyright (c) @CompanyNameMagicTag 2024-2024. All rights reserved.
#===============================================================================
config SAMPLE_SUPPORT_IR_STUDY
    bool
    prompt "Enable IR study."
    default n
    depends on DRIVER_SUPPORT_IR
    help
        This option means the IR study.

config SAMPLE_IR_SEND_PIN
    int
    prompt "Choose ir send pin."
    depends on DRIVER_SUPPORT_IR
    default 29

config SAMPLE_IR_STUDY_PIN
    int
    prompt "Choose ir study pin."
    depends on SAMPLE_SUPPORT_IR_STUDY
    default 28
```

## drivers/drivers/driver/keyscan/Kconfig
```kconfig
#===============================================================================
# @brief    Kconfig file.
# Copyright (c) @CompanyNameMagicTag 2022-2022. All rights reserved.
#===============================================================================
config KEYSCAN_REPORT_MAX_NUMS
    int
    prompt "The maximum number of key combinations that can be reported at one time, support 6/7/8/10"
    default 6
    depends on DRIVER_SUPPORT_KEYSCAN

config KEYSCAN_SUPPORT_LPM
    bool
    prompt "KEYSCAN Support low power mode, suspend and resume."
    default n
    depends on DRIVER_SUPPORT_KEYSCAN

config KEYSCAN_SUPPORT_SLEEP
    bool
    prompt "KEYSCAN Support low power mode, enter sleep."
    default n
    depends on DRIVER_SUPPORT_KEYSCAN

config KEYSCAN_IDLE_WAIT_US
    int
    prompt "KEYSCAN Set a timer to enter sleep"
    default 60000000
    depends on DRIVER_SUPPORT_KEYSCAN
```

## drivers/drivers/driver/pdm/Kconfig
```kconfig
#===============================================================================
# @brief    Kconfig file.
# Copyright (c) @CompanyNameMagicTag 2023-2023. All rights reserved.
#===============================================================================
config PDM_SUPPORT_LPC
    bool
    prompt "PDM Support low power control, control power and clock"
    default n
    depends on DRIVER_SUPPORT_PDM

config PDM_SUPPORT_QUERY_REGS
    bool
    prompt "PDM support query regs values"
    default n
    depends on DRIVER_SUPPORT_PDM
```

## drivers/drivers/driver/pinmux/Kconfig
```kconfig
#===============================================================================
# @brief    Kconfig file.
# Copyright (c) @CompanyNameMagicTag 2023-2023. All rights reserved.
#===============================================================================
config PINCTRL_SUPPORT_LPM
    bool
    prompt "PINCTRL Support low power mode, supend and reusme"
    default n
    depends on DRIVER_SUPPORT_PINCTRL
```

## drivers/drivers/driver/pm/Kconfig
```kconfig
#===============================================================================
# @brief    Kconfig file.
# Copyright (c) @CompanyNameMagicTag 2022-2022. All rights reserved.
#===============================================================================
config PM_SUPPORT_CLOCK_CRG_API
    bool
    prompt "SUPPORT CLOCK CRG API."
    default y
    depends on DRIVER_SUPPORT_PM
```

## drivers/drivers/driver/security/hash/Kconfig
```kconfig
#===============================================================================
# @brief    Kconfig file.
# Copyright (c) @CompanyNameMagicTag 2022-2022. All rights reserved.
#===============================================================================
config HASH_SUPPORT_SHA512
    bool
    prompt "Hash support SHA512"
    default n
    depends on DRIVER_SUPPORT_HASH
```
