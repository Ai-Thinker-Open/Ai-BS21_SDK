## drivers/drivers/driver/sfc/Kconfig
```kconfig
#===============================================================================
# @brief    Kconfig file.
# Copyright (c) @CompanyNameMagicTag 2022-2022. All rights reserved.
#===============================================================================
config SFC_SUPPORT_DMA
    bool
    prompt "SFC Support DMA."
    default y
    depends on DRIVER_SUPPORT_SFC

config SFC_ALLOW_ERASE_WRITEBACK
    bool
    prompt "Allows Erase at Any Address, needs 4KB RAM at least."
    default n
    depends on DRIVER_SUPPORT_SFC

config SFC_ALREADY_INIT
    bool
    prompt "SFC has been inited, need not to set reg in init/deinit func."
    default n
    depends on DRIVER_SUPPORT_SFC

config SFC_SUPPORT_LPM
    bool
    prompt "SFC Support low power mode, supend and reusme."
    default n
    depends on DRIVER_SUPPORT_SFC

config SFC_SUPPORT_DATA_CACHE
    bool
    prompt "SFC Support data cache"
    default n
    depends on DRIVER_SUPPORT_SFC

config SFC_SUPPORT_RWE_INDEPENDENT
    bool
    prompt "Independent sfc read/write erase interface."
    default n
    depends on DRIVER_SUPPORT_SFC

config SFC_SUPPORT_WRITE_PROTECT
    bool
    prompt "SFC Support write protect."
    default n
    depends on DRIVER_SUPPORT_SFC

config SFC_USE_CUSTOMIZED_DEVICE_INFO
    bool
    prompt "SFC use custom device information, which is defined in the porting"
    default n
    depends on DRIVER_SUPPORT_SFC
```

## drivers/drivers/driver/systick/Kconfig
```kconfig
#===============================================================================
# @brief    Kconfig file.
# Copyright (c) @CompanyNameMagicTag 2023-2023. All rights reserved.
#===============================================================================
config SYSTICK_SUPPORT_LPM
    bool
    prompt "Systick Support low power mode, supend and reusme"
    default n
    depends on DRIVER_SUPPORT_SYSTICK
```

## drivers/drivers/driver/uart/Kconfig
```kconfig
#===============================================================================
# @brief    Kconfig file.
# Copyright (c) @CompanyNameMagicTag 2022-2022. All rights reserved.
#===============================================================================
config UART_BAUD_RATE_DIV_8
    bool
    prompt "UART Baud rate div 8"
    default y
    depends on DRIVER_SUPPORT_UART

config UART_SUPPORT_TX
    bool
    prompt "UART Support TX"
    default y
    depends on DRIVER_SUPPORT_UART

config UART_SUPPORT_TX_INT
    bool
    prompt "UART Support TX interriupt mode"
    default y
    depends on DRIVER_SUPPORT_UART

config UART_SUPPORT_RX
    bool
    prompt "UART Support RX"
    default y
    depends on DRIVER_SUPPORT_UART

config UART_SUPPORT_DMA
    bool
    prompt "UART Support dma"
    default y
    depends on DRIVER_SUPPORT_UART
    select DRIVER_SUPPORT_DMA

config UART_SUPPORT_SEND_IN_DMA_ISR
    bool
    prompt "UART Support send in dma isr"
    default n
    depends on DRIVER_SUPPORT_DMA

config UART_SUPPORT_INT_TRIGGER_DMA
    bool
    prompt "UART Support rx interrupt trigger dma"
    default y
    depends on UART_SUPPORT_DMA

config UART_SUPPORT_FLOW_CTRL
    bool
    prompt "UART Support flow control"
    default n
    depends on DRIVER_SUPPORT_UART

config UART_SUPPORT_HW_FLOW_CTRL
    bool
    prompt "UART Support hardware flow control"
    default n
    depends on UART_SUPPORT_FLOW_CTRL

config UART_SUPPORT_SW_FLOW_CTRL
    bool
    prompt "UART Support software flow control"
    default n
    depends on UART_SUPPORT_FLOW_CTRL

config UART_SUPPORT_LPM
    bool
    prompt "UART Support low power mode, supend and reusme"
    default y
    depends on DRIVER_SUPPORT_UART

config UART_FIFO_DEPTH
    int
    prompt "UART_FIFO_DEPTH"
    range 64 128
    default 64
    depends on DRIVER_SUPPORT_UART

config UART_SUPPORT_LPC
    bool
    prompt "UART Support low power control, control power and clock"
    default n
    depends on DRIVER_SUPPORT_UART

config UART_MULTI_CORE_RESUME
    bool
    prompt "UART Support low power resume skip some port for multi-core"
    default n
    depends on UART_SUPPORT_LPM


config UART_NOT_SUPPORT_RX_CONDITON_SIZE_OPTIMIZE
    bool
    prompt "UART don't support rx condition size optimization"
    default n
    depends on UART_SUPPORT_RX

config UART_SUPPORT_QUERY_REGS
    bool
    prompt "UART support query regs values"
    default n
    depends on DRIVER_SUPPORT_UART

config UART_L0_TX_PIN
    int
    prompt "UART config uart l0 tx pin"
    default 19
    depends on DRIVER_SUPPORT_UART

config UART_L0_RX_PIN
    int
    prompt "UART config uart l0 rx pin"
    default 20
    depends on DRIVER_SUPPORT_UART

config UART_H0_TX_PIN
    int
    prompt "UART config uart h0 tx pin"
    default 17
    depends on DRIVER_SUPPORT_UART

config UART_H0_RX_PIN
    int
    prompt "UART config uart h0 rx pin"
    default 18
    depends on DRIVER_SUPPORT_UART

config UART_H0_CTS_PIN
    int
    prompt "UART config uart h0 cts pin, which is not used by default"
    default 100
    depends on UART_SUPPORT_FLOW_CTRL

config UART_H0_RTS_PIN
    int
    prompt "UART config uart h0 rts pin, which is not used by default"
    default 100
    depends on UART_SUPPORT_FLOW_CTRL
```
