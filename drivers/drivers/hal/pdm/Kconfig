## kernel/liteos/liteos_v208.6.0_b017/Huawei_LiteOS/targets/Kconfig.qemu
```kconfig
config LOSCFG_PLATFORM
    string
    default "qemu-virt-a53"   if LOSCFG_PLATFORM_QEMU_VIRT_A53_GIC_V2 || LOSCFG_PLATFORM_QEMU_VIRT_A53_GIC_V3
    default "realview-pbx-a9" if LOSCFG_PLATFORM_PBX_A9

choice
    prompt "Board"
    depends on LOSCFG_FAMILY_QEMU
    default LOSCFG_PLATFORM_PBX_A9

config LOSCFG_PLATFORM_PBX_A9
    bool "realview-pbx-a9"
    select LOSCFG_ARCH_CORTEX_A9
    select LOSCFG_ARM_GIC_V2
    select LOSCFG_ARM_PRIVATE_TIMER
    select LOSCFG_ARM_SP804_HRTIMER
    select LOSCFG_DRIVERS_UART_ARM_PL011
    select LOSCFG_DRIVERS_UART_LITEOS

config LOSCFG_PLATFORM_QEMU_VIRT_A53_GIC_V2
    bool "qemu-virt-a53_gicv2"
    select LOSCFG_ARCH_CORTEX_A53
    select LOSCFG_ARCH_ARM_AARCH64
    select LOSCFG_ARM_GIC_V2
    select LOSCFG_ARM_GENERIC_TIMER
    select LOSCFG_DRIVERS_USE_VENDOR_HISI_CAMERA
    select LOSCFG_DRIVERS_UART_ARM_PL011
    select LOSCFG_DRIVERS_UART_LINUX

config LOSCFG_PLATFORM_QEMU_VIRT_A53_GIC_V3
    bool "qemu-virt-a53_gicv3"
    select LOSCFG_ARCH_CORTEX_A53
    select LOSCFG_ARCH_ARM_AARCH64
    select LOSCFG_ARM_GIC_V3
    select LOSCFG_ARM_GENERIC_TIMER
    select LOSCFG_DRIVERS_USE_VENDOR_HISI_CAMERA
    select LOSCFG_DRIVERS_UART_ARM_PL011
    select LOSCFG_DRIVERS_UART_LINUX

endchoice
```

## kernel/liteos/liteos_v208.6.0_b017/Huawei_LiteOS/targets/Kconfig.secret
```kconfig
config LOSCFG_PLATFORM
    string
    default "sd3403v100_dsp" if LOSCFG_PLATFORM_SD3403V100_DSP
    default "sd3403v100_mcu" if LOSCFG_PLATFORM_SD3403V100_MCU
    default "hi3536av100"    if LOSCFG_PLATFORM_HI3536AV100

choice
    prompt "Board"
    depends on LOSCFG_FAMILY_SECRET
    default LOSCFG_PLATFORM_SD3403V100_MCU

config LOSCFG_PLATFORM_SD3403V100_MCU
    bool "sd3403v100_mcu"
    select LOSCFG_PLATFORM_HISI_RISCV
    select LOSCFG_USING_BOARD_LD
    select LOSCFG_ARM_SP804_HRTIMER
    select LOSCFG_ARM_SP804_TIMER
    select LOSCFG_DRIVERS_UART_LINUX

config LOSCFG_PLATFORM_SD3403V100_DSP
    bool "sd3403v100_dsp"
    select LOSCFG_XTENSA_VISIONQ6_V3
    select LOSCFG_USING_BOARD_LD
    select LOSCFG_DRIVERS_UART_ARM_PL011
    select LOSCFG_XTENSA_XEA3_TIMER
    select LOSCFG_XEA3_INT_CONTROLLER
    select LOSCFG_DRIVERS_UART_LINUX

config LOSCFG_PLATFORM_HI3536AV100
    bool "hi3536av100"
    select LOSCFG_PLATFORM_HISI_RISCV
    select LOSCFG_USING_BOARD_LD
    select LOSCFG_ARM_SP804_HRTIMER
    select LOSCFG_ARM_SP804_TIMER
    select LOSCFG_DRIVERS_UART_LINUX

endchoice
```

## kernel/liteos/liteos_v208.6.0_b017/Huawei_LiteOS/targets/Kconfig.stb
```kconfig
config LOSCFG_PLATFORM
    string
    default "hi3796cv300"     if LOSCFG_PLATFORM_HI3796CV300
    default "hi3751_dmcu"     if LOSCFG_PLATFORM_HI3751_DMCU

choice
    prompt "Board"
    depends on LOSCFG_FAMILY_STB
    default LOSCFG_PLATFORM_HI3796CV300

config LOSCFG_PLATFORM_HI3796CV300
    bool "hi3796cv300"
    select LOSCFG_ARCH_LINXCORE_131
    select LOSCFG_RISCV32_M_TIMER
    select LOSCFG_DRIVERS_UART_ARM_PL011
    select LOSCFG_USING_BOARD_LD

config LOSCFG_PLATFORM_HI3751_DMCU
    bool "hi3751_dmcu"
    select LOSCFG_ARCH_LINXCORE_131
    select LOSCFG_ARCH_RISCV_ISA_F
    select LOSCFG_RISCV32_M_TIMER
    select LOSCFG_DRIVERS_UART_LITEOS
    select LOSCFG_DRIVERS_UART_ARM_PL011
    select LOSCFG_USING_BOARD_LD
endchoice
```

## kernel/liteos/liteos_v208.6.0_b017/Huawei_LiteOS/targets/Kconfig.stm32
```kconfig
config LOSCFG_PLATFORM
    string
    default "STM32F769IDISCOVERY"  if LOSCFG_PLATFORM_STM32F769IDISCOVERY

choice
    prompt "Board"
    depends on LOSCFG_FAMILY_STM32
    default LOSCFG_PLATFORM_STM32F769IDISCOVERY

config LOSCFG_PLATFORM_STM32F769IDISCOVERY
    bool "STM32F769IDISCOVERY"
    select LOSCFG_ARCH_CORTEX_M7
    select LOSCFG_CORTEX_M_SYSTICK
    select LOSCFG_USING_BOARD_LD
    select LOSCFG_SCHED_LATENCY
    select LOSCFG_DRIVERS_UART_VENDOR

endchoice
```

## kernel/osal/Kconfig
```kconfig
#===============================================================================
# @brief    Kconfig file.
# Copyright (c) @CompanyNameMagicTag 2023-2023. All rights reserved.
#===============================================================================
config DRIVER_DISABLE_OSAL_LOG
    bool
    prompt "disable osal log"
    default n
    help
        This option means turn off osal log.
```

## middleware/utils/codec/Kconfig
```kconfig
#===============================================================================
# @brief    Kconfig file.
# Copyright (c) @CompanyNameMagicTag 2023-2023. All rights reserved.
#===============================================================================
config CODEC_ENABLE_SBC
    bool "SBC"
config CODEC_ENABLE_MSBC
    bool "MSBC"
config CODEC_ENABLE_OPUS
    bool "OPUS"
config CODEC_ENABLE_L2HC
    bool "L2HC"
```

## middleware/utils/dfx/Kconfig
```kconfig
#===============================================================================
# @brief    Kconfig file.
# Copyright (c) @CompanyNameMagicTag 2023-2023. All rights reserved.
#===============================================================================
config DFX_SUPPORT_USERS_PRINT
    bool
    prompt "ENABLE USER TO REGISTER LOG API."
    default y
    depends on MIDDLEWARE_SUPPORT_DFX
config DFX_SUPPORT_PRINT
    bool
    prompt "dfx print with level limit"
    default n
    depends on MIDDLEWARE_SUPPORT_DFX
config CONFIG_ERRCODE_SUPPORT_REPORT
    bool
    prompt "Enable user to register errcode report callback."
    default n
    depends on MIDDLEWARE_SUPPORT_DFX
```

## middleware/utils/pm/Kconfig
```kconfig
#===============================================================================
# @brief    Kconfig file.
# Copyright (c) @CompanyNameMagicTag 2023-2023. All rights reserved.
#===============================================================================
config PM_SLEEP_RECORD_ENABLE
    bool
    prompt "ENABLE SLEEP RECORD."
    default y
    depends on MIDDLEWARE_SUPPORT_PM

config PM_POWER_GATING_ENABLE
    bool
    prompt "ENABLE POWERGATING."
    default y
    depends on MIDDLEWARE_SUPPORT_PM

config PM_VETO_TRACK_ENABLE
    bool
    prompt "VETO ENABLE TRACK."
    default y
    depends on MIDDLEWARE_SUPPORT_PM

config PM_LIGHT_SLEEP_THRESHOLD_MS
    int
    prompt "The light sleep time threshold."
    default 10
    depends on MIDDLEWARE_SUPPORT_PM

config PM_DEEP_SLEEP_THRESHOLD_MS
    int
    prompt "The deep sleep time threshold."
    default 20
    depends on MIDDLEWARE_SUPPORT_PM

config PM_DEBUG
    bool
    prompt "Enable DEBUG Record"
    default y
    depends on MIDDLEWARE_SUPPORT_PM

config PM_FSM_TRACE_NUM
    int
    prompt "Number of FSM Traces"
    default 32
    depends on MIDDLEWARE_SUPPORT_PM

config PM_ENABLE_WAKEUP_INTERRUPT
    bool
    prompt "Enable wakeup interrupt"
    default y
    depends on MIDDLEWARE_SUPPORT_PM

config PM_SYS_SUPPORT
    bool
    prompt "Pm sys support, switch system (work,standby,sleep) state."
    default n
    depends on MIDDLEWARE_SUPPORT_PM

config PM_SYS_SUPPORT_MSGQUEUE
    bool
    prompt "Pm sys support message queue."
    default y
    depends on MIDDLEWARE_SUPPORT_PM

config PM_SYS_STACK_SIZE
    int
    prompt "Pm sys stack size."
    default 2048
    depends on PM_SYS_SUPPORT_MSGQUEUE
```

## middleware/utils/update/Kconfig
```kconfig
#===============================================================================
# @brief    Kconfig file.
# Copyright (c) @CompanyNameMagicTag 2024-2024. All rights reserved.
#===============================================================================
config BT_UPG_ENABLE
    bool
    prompt "ENABLE BLE OTA."
    default n
    depends on MIDDLEWARE_SUPPORT_UPDATE

config SLE_UPG_ENABLE
    bool
    prompt "ENABLE SLE OTA."
    default n
    depends on MIDDLEWARE_SUPPORT_UPDATE

config OTA_LOG_ENABLE
    bool
    prompt "ENABLE OTA LOG."
    default n
    depends on MIDDLEWARE_SUPPORT_UPDATE
```

## protocol/Kconfig
```kconfig
choice
    prompt "Select sle ble support"
    default SUPPORT_SLE_BLE_CENTRAL_DEFAULT
    config SUPPORT_SLE_BLE_CENTRAL_DEFAULT
        bool "Select sle ble central default."
    config SUPPORT_SLE_BLE_PERIPHERAL
        bool "Select sle ble peripheral."
    config SUPPORT_SLE_PERIPHERAL
        bool "Select sle peripheral."
    config SUPPORT_SLE_CENTRAL
        bool "Select sle central."
    config SUPPORT_BLE_PERIPHERAL
        bool "Select ble peripheral."
    config PRODUCT_SLE_MICROPHONE
        bool "Select sle microphone."
    config SUPPORT_SLEM_PERIPHERAL
        bool "Select sle measure peripheral."
    config SUPPORT_SLEM_CENTRAL
        bool "Select sle measure central."
    config PRODUCT_SLE_MEASURE_DIS
        bool "Select sle measure dis."
endchoice

config SLE_BLE_RELEASE_SUPPORT
    bool
    prompt "Enable sle ble release."
    default n
    help
        This option means close sle ble log.

config SLE_BLE_SUPPORT
    string
    default "sle-ble-peripheral" if (SUPPORT_SLE_BLE_PERIPHERAL && !SLE_BLE_RELEASE_SUPPORT)
    default "sle-ble-peripheral-release" if (SUPPORT_SLE_BLE_PERIPHERAL && SLE_BLE_RELEASE_SUPPORT)
    default "sle-peripheral" if (SUPPORT_SLE_PERIPHERAL && !SLE_BLE_RELEASE_SUPPORT)
    default "sle-peripheral-release" if (SUPPORT_SLE_PERIPHERAL && SLE_BLE_RELEASE_SUPPORT)
    default "sle-central" if (SUPPORT_SLE_CENTRAL && !SLE_BLE_RELEASE_SUPPORT)
    default "sle-central-release" if (SUPPORT_SLE_CENTRAL && SLE_BLE_RELEASE_SUPPORT)
    default "sle-microphone" if (PRODUCT_SLE_MICROPHONE && !SLE_BLE_RELEASE_SUPPORT)
    default "sle-microphone-release" if (PRODUCT_SLE_MICROPHONE && SLE_BLE_RELEASE_SUPPORT)
    default "slem-peripheral" if (SUPPORT_SLEM_PERIPHERAL && !SLE_BLE_RELEASE_SUPPORT)
    default "slem-peripheral-release" if (SUPPORT_SLEM_PERIPHERAL && SLE_BLE_RELEASE_SUPPORT)
    default "slem-central" if (SUPPORT_SLEM_CENTRAL && !SLE_BLE_RELEASE_SUPPORT)
    default "slem-central-release" if (SUPPORT_SLEM_CENTRAL && SLE_BLE_RELEASE_SUPPORT)
    default "ble-peripheral" if (SUPPORT_BLE_PERIPHERAL && !SLE_BLE_RELEASE_SUPPORT)
    default "ble-peripheral-release" if (SUPPORT_BLE_PERIPHERAL && SLE_BLE_RELEASE_SUPPORT)
    default "sle-measure-dis" if (PRODUCT_SLE_MEASURE_DIS && !SLE_BLE_RELEASE_SUPPORT)
    default "sle-measure-dis-release" if (PRODUCT_SLE_MEASURE_DIS && SLE_BLE_RELEASE_SUPPORT)

config BT_SLE_ONLY
    bool
    default y if (SUPPORT_SLE_PERIPHERAL || SUPPORT_SLE_CENTRAL || SUPPORT_SLEM_PERIPHERAL || SUPPORT_SLEM_CENTRAL)

config BT_BLE_ONLY
    bool
    default y if (SUPPORT_BLE_PERIPHERAL)


menu "bt_host"
    comment "Config bluetooth."
    osource "protocol/bt/host/Kconfig"
endmenu

menu "nfc"
    config SUPPORT_NFC_SERVICE
    bool
    prompt "Config nfc."
    default n
    help
        This option means support NFC.
endmenu
```

## protocol/bt/host/gle/Kconfig
```kconfig
#===============================================================================
# @brief    SLE feature config.
# Copyright (c) @CompanyNameMagicTag 2023-2023. All rights reserved.
#===============================================================================
config FEATURE_GLE_LOW_LATENCY
    bool
    prompt "Using gle low latency feature."
    default n

config FEATURE_GLE_HADM
    bool
    prompt "Using gle hadm feature."
    default n

config FEATURE_GLE_PERFORMANCE_SUPPORT
    bool
    prompt "Using gle performance feature."
    default n
```
