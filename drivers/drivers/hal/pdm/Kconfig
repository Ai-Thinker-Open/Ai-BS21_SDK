## drivers/drivers/hal/pdm/Kconfig
```kconfig
#===============================================================================
# @brief    Kconfig file.
# Copyright (c) @CompanyNameMagicTag 2023-2023. All rights reserved.
#===============================================================================
config PDM_USING_V150
    bool
    prompt "Using PDM V150"
    default y
    depends on DRIVER_SUPPORT_PDM

config PDM_USING_V151
    bool
    prompt "Using PDM V151"
    default n
    depends on DRIVER_SUPPORT_PDM

config MIC_CH_NUM
    int
    prompt "Max number of the MIC"
    range 0 3
    default 3
    depends on PDM_USING_V150

config PDM_AFIFO_AEMPTY_TH
    int
    prompt "The atemp to be EMPTY threshold of MIC."
    default 3
    depends on DRIVER_SUPPORT_PDM

config PDM_AFIFO_AFULL_TH
    int
    prompt "The atemp to be FULL threshold of MIC."
    default 16
    depends on DRIVER_SUPPORT_PDM

config PDM_ADC_DC_OFFSET
    int
    prompt "HPF DC Offset."
    default 0
    depends on DRIVER_SUPPORT_PDM

config PDM_CIC_GAIN
    hex
    prompt "The PDM CIC gain."
    default 0x14
    depends on DRIVER_SUPPORT_PDM

config PDM_LP_CIC_GAIN
    hex
    prompt "The Low power PDM CIC gain."
    default 0x0
    depends on DRIVER_SUPPORT_PDM
```

## drivers/drivers/hal/sfc/Kconfig
```kconfig
#===============================================================================
# @brief    Kconfig file.
# Copyright (c) @CompanyNameMagicTag 2022-2022. All rights reserved.
#===============================================================================
config SFC_DEBUG
    bool
    prompt "SFC Support DEBUG"
    default y
    depends on DRIVER_SUPPORT_SFC
```

## drivers/drivers/hal/systick/Kconfig
```kconfig
#===============================================================================
# @brief    Kconfig file.
# Copyright (c) @CompanyNameMagicTag 2024-2024. All rights reserved.
#===============================================================================

config SYSTICK_WITH_TWO_DATA_REGS
    bool
    prompt "Systick Calculated With Two Data Registers "
    default n
    depends on DRIVER_SUPPORT_SYSTICK
```

## drivers/drivers/hal/tcxo/Kconfig
```kconfig
#===============================================================================
# @brief    Kconfig file.
# Copyright (c) @CompanyNameMagicTag 2024-2024. All rights reserved.
#===============================================================================

config TCXO_WITH_TWO_DATA_REGS
    bool
    prompt "TCXO Calculated With Two Data Registers "
    default n
    depends on DRIVER_SUPPORT_TCXO
```

## kernel/liteos/liteos_v208.6.0_b017/Huawei_LiteOS/drivers/Kconfig
```kconfig
menu "Driver"

osource "drivers/base/Kconfig"
osource "drivers/interrupt/Kconfig"
osource "drivers/timer/Kconfig"

config LOSCFG_DRIVERS_UART_LITEOS
    bool
    help
      uart is implemented using the LiteOS driver framework.

osource "drivers/uart/Kconfig"

osource "drivers/mmc/adapt_liteos/Kconfig"
osource "drivers/iommu/Kconfig"

config LOSCFG_DRIVERS_MTD
    bool "Enable MTD"
    default n
    depends on LOSCFG_FS_VFS
    select LOSCFG_COMPAT_LINUX
    select LOSCFG_COMPAT_LINUX_DRIVER_BASE
    select LOSCFG_COMPAT_LINUX_MTD_LIST
    help
      Answer Y to enable LiteOS support yaffs and jffs2 multipartion.

osource "drivers/random/Kconfig"
osource "drivers/usb/adapt_liteos/Kconfig"
osource "drivers/video/Kconfig"
osource "drivers/cipher/Kconfig"

config LOSCFG_DRIVERS_USE_VENDOR_HISI_CAMERA
    bool
    help
      This option will import the drivers in vendor/hisi/camera/drivers.
      Usually only hisi camera socs can use those drivers, but maybe some
      legacy platforms are still using vendor uart driver.

      Select this if you want to use hisi camera vendor drivers.

config LOSCFG_DRIVERS_VENDOR_PATH
    string
    default "vendor/hisi/camera/drivers" if LOSCFG_DRIVERS_USE_VENDOR_HISI_CAMERA

#
# If vendor drivers are used, for dependency concern, the vendor Kconfig needs
# to define LOSCFG_DRIVERS_USE_VENDOR_DRIVERS. So when vendor drivers are deleted,
# the compiling system will not reference those folders.
#
# Attention: When the menuconfig system importing this kconfig, the vendor path
# config LOSCFG_DRIVERS_VENDOR_PATH is not ready yet. Therefore, the path needs
# to be explicitly used here.
#
if LOSCFG_DRIVERS_USE_VENDOR_HISI_CAMERA
osource "vendor/hisi/camera/drivers/Kconfig"
endif

endmenu
```

## kernel/liteos/liteos_v208.6.0_b017/Huawei_LiteOS/net/Kconfig
```kconfig
menu "Net"
#config LOSCFG_NET_LWIP
#   bool "Enable Lwip"
#   default y

#   help
#     extend kernel include runstop, dynload, scatter and cppsupport.
#     It can support all or some.

config LOSCFG_NET_LWIP_SACK
    bool "Enable Lwip"
    default y
    select LOSCFG_FS_VFS
    select LOSCFG_LIB_STDIO
    select LOSCFG_COMPAT_LINUX
    select LOSCFG_COMPAT_LINUX_WAITQUEUE
    help
      Answer Y to enable LiteOS support lwip.

config LOSCFG_NET_IPERF
    bool "Enable Iperf"
    depends on LOSCFG_NET_LWIP_SACK
    default n
    help
      Answer Y to enable LiteOS support iperf.

config LOSCFG_NET_IPERF_JITTER
    bool "Enable Udp Jitter"
    depends on LOSCFG_NET_IPERF
    default n
    help
      Answer Y to enable Iperf support jitter statistics

osource "net/telnet/Kconfig"
endmenu
```

## kernel/liteos/liteos_v208.6.0_b017/Huawei_LiteOS/targets/Kconfig
```kconfig
choice
    prompt "Family"

config LOSCFG_FAMILY_BVT
    bool "BVT"
    select LOSCFG_DRIVERS_USE_VENDOR_HISI_CAMERA

config LOSCFG_FAMILY_DPT
    bool "DPT"
    select LOSCFG_DRIVERS_USE_VENDOR_HISI_CAMERA

config LOSCFG_FAMILY_AIOT
    bool "AIOT"

config LOSCFG_FAMILY_STB
    bool "STB"

config LOSCFG_FAMILY_QEMU
    bool "QEMU"

config LOSCFG_FAMILY_STM32
    bool "STM32"

config LOSCFG_FAMILY_SECRET
    bool "SECRET"
    select LOSCFG_DRIVERS_USE_VENDOR_HISI_CAMERA

config LOSCFG_FAMILY_HQ
    bool "HQ"

config LOSCFG_FAMILY_ENERGY
    bool "ENERGY"

config LOSCFG_FAMILY_SHC
    bool "SHC"

config LOSCFG_FAMILY_ASCEND
    bool "ASCEND"

config LOSCFG_FAMILY_DATACOM
    bool "DATACOM"

endchoice

config LOSCFG_FAMILY
    string
    default "aiot" if LOSCFG_FAMILY_AIOT

osource "targets/Kconfig.bvt"
osource "targets/Kconfig.dpt"
osource "targets/Kconfig.aiot"
osource "targets/Kconfig.stb"
osource "targets/Kconfig.qemu"
osource "targets/Kconfig.stm32"
osource "targets/Kconfig.secret"
osource "targets/Kconfig.hq"
osource "targets/Kconfig.energy"
osource "targets/Kconfig.shc"
osource "targets/Kconfig.ascend"
osource "targets/Kconfig.datacom"

config LOSCFG_PLATFORM_ASCEND
    bool
    select LOSCFG_ARM_GENERIC_TIMER
    select LOSCFG_ARM_GIC_V3
    select LOSCFG_USING_BOARD_LD
    select LOSCFG_DRIVERS_UART_LITEOS
    select LOSCFG_DRIVERS_UART_ARM_PL011
    help
        This is genenel setup for 64bit ARMv8 based ascend platforms which should directly
        select this option and add specific processor cores.


config LOSCFG_PLATFORM_HISI_BVT_ARM
    bool
    select LOSCFG_ARM_GIC_V2
    select LOSCFG_ARM_GENERIC_TIMER
    select LOSCFG_ARM_SP804_HRTIMER
    select LOSCFG_DRIVERS_UART_ARM_PL011
    select LOSCFG_DRIVERS_UART_LINUX
    help
        This is genenel setup for 32bit ARMv7/8 based platforms which should directly
        select this option and add specific processor cores. For example:

        config LOSCFG_PLATFORM_HI35xxVxxx
            bool "HI35xxVxxx"
            select LOSCFG_ARCH_CORTEX_A7
            select LOSCFG_PLATFORM_HISI_BVT_ARM

config LOSCFG_PLATFORM_HISI_RISCV
    bool
    select LOSCFG_ARCH_LINXCORE_131
    select LOSCFG_ARM_SP804_TIMER
    select LOSCFG_DRIVERS_UART_ARM_PL011
    help
        This is genenel setup for risc-v based hisilicon platforms which should directly
        select this option and add specific processor cores.

config LOSCFG_USING_BOARD_LD
    bool

config LOSCFG_USING_BOARD_RESET_VECTOR
    bool
    default n
    help
        Use board reset vector instead of arch default implementation.

config LOSCFG_PLATFORM_EXTENDED_FEATURE
    string
    default "normal"  if LOSCFG_PLATFORM_STM32F769IDISCOVERY_N
    default "safety"  if LOSCFG_PLATFORM_STM32F769IDISCOVERY_S
    default "safety_rom"  if LOSCFG_PLATFORM_STM32F769IDISCOVERY_S_ROM

choice
    prompt "Extended Feature"
    depends on LOSCFG_PLATFORM_STM32F769IDISCOVERY

config LOSCFG_PLATFORM_STM32F769IDISCOVERY_N
    bool "normal"

config LOSCFG_PLATFORM_STM32F769IDISCOVERY_S
    bool "safety"
    select LOSCFG_SAFETY_KERNEL

config LOSCFG_PLATFORM_STM32F769IDISCOVERY_S_ROM
    bool "safety_rom"
    select LOSCFG_SAFETY_KERNEL
    select LOSCFG_MULTI_BINARIES
endchoice

config LOSCFG_USING_GCC_NOPIC_LIB
    bool
    default n
    depends on LOSCFG_PLATFORM_HI3892_SE
    help
        When the platform is RISCV, the gcc library is changed to gcc-nopic.

choice
    prompt "Board Type"
    depends on LOSCFG_PLATFORM_ISP_V500
    default LOSCFG_PLATFORM_ISP_V500_NSV

config LOSCFG_PLATFORM_ISP_V500_NSV
    bool "Nashville"
    select LOSCFG_ARM_GENERIC_TIMER
    select LOSCFG_DRIVERS_UART_HQ_UART_V502

config LOSCFG_PLATFORM_ISP_V500_FPGA
    bool "Nashville FPGA"
    select LOSCFG_RISCV_HQTIMER_V510
    select LOSCFG_DRIVERS_UART_HQ_UART_V502

config LOSCFG_PLATFORM_ISP_V500_ESL
    bool "Nashville ESL"
    select LOSCFG_ARM_GENERIC_TIMER
    select LOSCFG_DRIVERS_UART_ARM_PL011

endchoice
```

## kernel/liteos/liteos_v208.6.0_b017/Huawei_LiteOS/targets/Kconfig.aiot
```kconfig
config LOSCFG_PLATFORM
    string
    default "bs20"            if LOSCFG_PLATFORM_BS20
    default "bs21"            if LOSCFG_PLATFORM_BS21
    default "bs21a"           if LOSCFG_PLATFORM_BS21A
    default "bs22"            if LOSCFG_PLATFORM_BS22
    default "bs25"            if LOSCFG_PLATFORM_BS25
    default "bs26"            if LOSCFG_PLATFORM_BS26
    default "ws63"            if LOSCFG_PLATFORM_WS63
    default "suqin_app"       if LOSCFG_PLATFORM_SUQIN_APP
    default "sushik_app"      if LOSCFG_PLATFORM_SUSHIK_APP
    default "socmn1"          if LOSCFG_PLATFORM_SOCMN1
    default "sw39_bt"         if LOSCFG_PLATFORM_SW39_BT

choice
    prompt "Board"
    depends on LOSCFG_FAMILY_AIOT
    default LOSCFG_PLATFORM_BS25

config LOSCFG_PLATFORM_BS20
    bool "bs20"
    select LOSCFG_ARCH_RISCV_ISA_F
    select LOSCFG_ARCH_LINXCORE_131
    select LOSCFG_TIMER_VENDOR
    select LOSCFG_DRIVERS_UART_VENDOR
    select LOSCFG_USING_BOARD_LD
    select LOSCFG_USING_BOARD_RESET_VECTOR
    select LOSCFG_DRIVERS_USB_DEVICE_NO_DRIVER_BASE

config LOSCFG_PLATFORM_BS21
    bool "bs21"
    select LOSCFG_ARCH_RISCV_ISA_F
    select LOSCFG_ARCH_LINXCORE_131
    select LOSCFG_TIMER_VENDOR
    select LOSCFG_DRIVERS_UART_VENDOR
    select LOSCFG_USING_BOARD_LD
    select LOSCFG_USING_BOARD_RESET_VECTOR
    select LOSCFG_DRIVERS_USB_DEVICE_NO_DRIVER_BASE

config LOSCFG_PLATFORM_BS21A
    bool "bs21a"
    select LOSCFG_ARCH_RISCV_ISA_F
    select LOSCFG_ARCH_LINXCORE_131
    select LOSCFG_TIMER_VENDOR
    select LOSCFG_DRIVERS_UART_VENDOR
    select LOSCFG_USING_BOARD_LD
    select LOSCFG_USING_BOARD_RESET_VECTOR
    select LOSCFG_DRIVERS_USB_DEVICE_NO_DRIVER_BASE

config LOSCFG_PLATFORM_BS22
    bool "bs22"
    select LOSCFG_ARCH_RISCV_ISA_F
    select LOSCFG_ARCH_LINXCORE_131
    select LOSCFG_TIMER_VENDOR
    select LOSCFG_DRIVERS_UART_VENDOR
    select LOSCFG_USING_BOARD_LD
    select LOSCFG_USING_BOARD_RESET_VECTOR
    select LOSCFG_DRIVERS_USB_DEVICE_NO_DRIVER_BASE

config LOSCFG_PLATFORM_BS25
    bool "bs25"
    select LOSCFG_ARCH_LINXCORE_131
    select LOSCFG_ARCH_RISCV_RV32IMC
    select LOSCFG_RISCV_HIMIDEERV200_PLIC
    select LOSCFG_TIMER_VENDOR
    select LOSCFG_DRIVERS_UART_VENDOR
    select LOSCFG_USING_BOARD_LD
    select LOSCFG_ARCH_RISCV_RV32F
    select LOSCFG_ARCH_RISCV32
    select LOSCFG_USING_BOARD_RESET_VECTOR

config LOSCFG_PLATFORM_BS26
    bool "bs26"
    select LOSCFG_ARCH_RISCV_ISA_F
    select LOSCFG_ARCH_LINXCORE_131
    select LOSCFG_TIMER_VENDOR
    select LOSCFG_DRIVERS_UART_VENDOR
    select LOSCFG_USING_BOARD_LD
    select LOSCFG_USING_BOARD_RESET_VECTOR
    select LOSCFG_DRIVERS_USB_DEVICE_NO_DRIVER_BASE

config LOSCFG_PLATFORM_WS63
    bool "ws63"
    select LOSCFG_ARCH_RISCV_RV32IMC
    select LOSCFG_ARCH_LINXCORE_131
    select LOSCFG_RISCV_HIMIDEERV200_PLIC
    select LOSCFG_TIMER_VENDOR
    select LOSCFG_DRIVERS_UART_VENDOR
    select LOSCFG_USING_BOARD_LD
    select LOSCFG_ARCH_RISCV_RV32F
    select LOSCFG_ARCH_RISCV32
    select LOSCFG_USING_BOARD_RESET_VECTOR

config LOSCFG_PLATFORM_SUQIN_APP
    bool "suqin_app"
    select LOSCFG_ARCH_LINXCORE_170
    select LOSCFG_ARCH_RISCV_RV32F
    select LOSCFG_LCMP_CUSTOM_INST16_EXTENSIONS
    select LOSCFG_LCMP_CUSTOM_INST16_SUB_EXTENSIONS
    select LOSCFG_LCMP_CUSTOM_INST32_EXTENSIONS
    select LOSCFG_TIMER_VENDOR
    select LOSCFG_DRIVERS_UART_VENDOR
    select LOSCFG_USING_BOARD_LD
    select LOSCFG_USING_BOARD_RESET_VECTOR

config LOSCFG_PLATFORM_SOCMN1
    bool "socmn1"
    select LOSCFG_ARCH_CORTEX_M7
    select LOSCFG_ARCH_FPU_VFP_DP
    select LOSCFG_CORTEX_M_SYSTICK
    select LOSCFG_USING_BOARD_LD
    select LOSCFG_DRIVERS_UART_VENDOR

config LOSCFG_PLATFORM_SW39_BT
    bool "sw39_bt"
    select LOSCFG_ARCH_LINXCORE_170
    select LOSCFG_ARCH_RISCV_RV32F
    select LOSCFG_LCMP_CUSTOM_INST16_EXTENSIONS
    select LOSCFG_LCMP_CUSTOM_INST16_SUB_EXTENSIONS
    select LOSCFG_LCMP_CUSTOM_INST32_EXTENSIONS
    select LOSCFG_TIMER_VENDOR
    select LOSCFG_DRIVERS_UART_VENDOR
    select LOSCFG_USING_BOARD_LD
    select LOSCFG_USING_BOARD_RESET_VECTOR

endchoice
```
