## kernel/liteos/liteos_v208.6.0_b017/Huawei_LiteOS/targets/Kconfig.bvt
```kconfig
config LOSCFG_PLATFORM
    string
    default "hi3556v200"      if LOSCFG_PLATFORM_HI3556V200
    default "hi3556v200_dcg"  if LOSCFG_PLATFORM_HI3556V200_DCG
    default "hi3516ev200"     if LOSCFG_PLATFORM_HI3516EV200
    default "hi3556av100"     if LOSCFG_PLATFORM_HI3556AV100
    default "hi3559av100"     if LOSCFG_PLATFORM_HI3559AV100
    default "hi3516dv500"     if LOSCFG_PLATFORM_HI3516DV500
    default "hi3516cv610"     if LOSCFG_PLATFORM_HI3516CV610

choice
    prompt "Board"
    depends on LOSCFG_FAMILY_BVT
    default LOSCFG_PLATFORM_HI3556V200

config LOSCFG_PLATFORM_HI3556V200
    bool "hi3556v200"
    select LOSCFG_ARCH_CORTEX_A7
    select LOSCFG_PLATFORM_HISI_BVT_ARM
    select LOSCFG_HW_RANDOM_HISEC_TRNG

config LOSCFG_PLATFORM_HI3556V200_DCG
    bool "hi3556v200_dcg"
    select LOSCFG_ARCH_CORTEX_A7
    select LOSCFG_PLATFORM_HISI_BVT_ARM
    select LOSCFG_HW_RANDOM_HISEC_TRNG

config LOSCFG_PLATFORM_HI3516EV200
    bool "hi3516ev200"
    select LOSCFG_ARCH_CORTEX_A7
    select LOSCFG_ARM_GIC_V2
    select LOSCFG_ARM_SP804_TIMER
    select LOSCFG_ARM_SP804_ADVANCED
    select LOSCFG_ARM_SP804_HRTIMER
    select LOSCFG_DRIVERS_UART_ARM_PL011
    select LOSCFG_DRIVERS_UART_LINUX
    select LOSCFG_HW_RANDOM_HISEC_TRNG

config LOSCFG_PLATFORM_HI3556AV100
    bool "hi3556av100"
    select LOSCFG_ARCH_CORTEX_A53_AARCH32
    select LOSCFG_ARM_GIC_V2
    select LOSCFG_ARM_SP804_TIMER
    select LOSCFG_ARM_SP804_ADVANCED
    select LOSCFG_ARM_SP804_HRTIMER
    select LOSCFG_DRIVERS_UART_ARM_PL011
    select LOSCFG_DRIVERS_UART_LINUX
    select LOSCFG_HW_RANDOM_HISEC_TRNG

config LOSCFG_PLATFORM_HI3559AV100
    bool "hi3559av100"
    select LOSCFG_ARCH_CORTEX_A53
    select LOSCFG_ARM_GIC_V2
    select LOSCFG_ARM_SP804_TIMER
    select LOSCFG_ARM_SP804_ADVANCED
    select LOSCFG_ARM_SP804_HRTIMER
    select LOSCFG_DRIVERS_UART_ARM_PL011
    select LOSCFG_DRIVERS_UART_LINUX
    select LOSCFG_HW_RANDOM_HISEC_TRNG

config LOSCFG_PLATFORM_HI3516DV500
    bool "hi3516dv500"
    select LOSCFG_ARCH_CORTEX_A55
    select LOSCFG_ARM_GIC_V3
    select LOSCFG_ARM_SP804_HRTIMER
    select LOSCFG_DRIVERS_UART_ARM_PL011
    select LOSCFG_DRIVERS_UART_LINUX
    select LOSCFG_HW_RANDOM_HISEC_TRNG
    select LOSCFG_ARM_GENERIC_TIMER
	
config LOSCFG_PLATFORM_HI3516CV610
    bool "hi3516cv610"
    select LOSCFG_ARCH_CORTEX_A7
    select LOSCFG_ARM_GIC_V2
    select LOSCFG_ARM_SP804_HRTIMER
    select LOSCFG_DRIVERS_UART_ARM_PL011
    select LOSCFG_DRIVERS_UART_LITEOS
    select LOSCFG_HW_RANDOM_HISEC_TRNG
    select LOSCFG_ARM_GENERIC_TIMER
endchoice
```

## kernel/liteos/liteos_v208.6.0_b017/Huawei_LiteOS/targets/Kconfig.datacom
```kconfig
config LOSCFG_PLATFORM
    string
    default "hc32f4a0_datacom"       if LOSCFG_PLATFORM_HC32F4A0_DATACOM

choice
    prompt "Board"
    depends on LOSCFG_FAMILY_DATACOM
    default LOSCFG_PLATFORM_HC32F4A0_DATACOM

config LOSCFG_PLATFORM_HC32F4A0_DATACOM
    bool "hc32f4a0_datacom"
    select LOSCFG_ARCH_CORTEX_M4
    select LOSCFG_CORTEX_M_NVIC
    select LOSCFG_CORTEX_M_SYSTICK
    select LOSCFG_USING_BOARD_LD
    select LOSCFG_DRIVERS_UART_VENDOR

endchoice
```

## kernel/liteos/liteos_v208.6.0_b017/Huawei_LiteOS/targets/Kconfig.dpt
```kconfig
config LOSCFG_PLATFORM
    string
    default "hi3731v110"      if LOSCFG_PLATFORM_HI3731V110

choice
    prompt "Board"
    depends on LOSCFG_FAMILY_DPT
    default LOSCFG_PLATFORM_HI3731V110

config LOSCFG_PLATFORM_HI3731V110
    bool "hi3731v110"
    select LOSCFG_PLATFORM_HISI_RISCV
    select LOSCFG_USING_BOARD_LD
    select LOSCFG_DRIVERS_UART_LINUX
endchoice
```

## kernel/liteos/liteos_v208.6.0_b017/Huawei_LiteOS/targets/Kconfig.energy
```kconfig
config LOSCFG_PLATFORM
    string
    default "hc32f4a0"       if LOSCFG_PLATFORM_HC32F4A0
    default "sd5010"         if LOSCFG_PLATFORM_SD5010
    default "stm32h747m4"    if LOSCFG_PLATFORM_STM32H747M4
    default "sd5091_plc"     if LOSCFG_PLATFORM_SD5091_PLC
    default "sd5012_linx131" if LOSCFG_PLATFORM_SD5012_LINX131
    default "sd5091"         if LOSCFG_PLATFORM_SD5091

choice
    prompt "Board"
    depends on LOSCFG_FAMILY_ENERGY
    default LOSCFG_PLATFORM_HC32F4A0

config LOSCFG_PLATFORM_HC32F4A0
    bool "hc32f4a0"
    select LOSCFG_ARCH_CORTEX_M4
    select LOSCFG_CORTEX_M_NVIC
    select LOSCFG_CORTEX_M_SYSTICK
    select LOSCFG_USING_BOARD_LD
    select LOSCFG_DRIVERS_UART_VENDOR

config LOSCFG_PLATFORM_SD5010
    bool "sd5010"
    select LOSCFG_ARCH_ARM_926
    select LOSCFG_ARM_V5_VIC
    select LOSCFG_TIMER_VENDOR
    select LOSCFG_DRIVERS_UART_VENDOR

config LOSCFG_PLATFORM_STM32H747M4
    bool "stm32h747m4"
    select LOSCFG_ARCH_CORTEX_M4
    select LOSCFG_CORTEX_M_NVIC
    select LOSCFG_CORTEX_M_SYSTICK
    select LOSCFG_USING_BOARD_LD
    select LOSCFG_DRIVERS_UART_VENDOR

config LOSCFG_PLATFORM_SD5091_PLC
    bool "sd5091_plc"
    select LOSCFG_ARCH_LINXCORE_170
    select LOSCFG_ARCH_RISCV_ISA_F
    select LOSCFG_TIMER_VENDOR
    select LOSCFG_DRIVERS_UART_VENDOR
    select LOSCFG_USING_BOARD_LD
    select LOSCFG_USING_BOARD_RESET_VECTOR
    select LOSCFG_SAFETY_KERNEL
    select LOSCFG_COMPILE_LIB_WITHOUT_OBJ

config LOSCFG_PLATFORM_SD5012_LINX131
    bool "sd5012_linx131"
    select LOSCFG_ARCH_LINXCORE_131
    select LOSCFG_USING_BOARD_LD
    select LOSCFG_TIMER_VENDOR
    select LOSCFG_DRIVERS_UART_VENDOR

config LOSCFG_PLATFORM_SD5091
    bool "sd5091"
    select LOSCFG_ARCH_CORTEX_A55
    select LOSCFG_ARCH_ARM_AARCH64
    select LOSCFG_ARM_GIC_V3
    select LOSCFG_ARM_SIC
    select LOSCFG_ARM_GENERIC_TIMER

endchoice
```

## kernel/liteos/liteos_v208.6.0_b017/Huawei_LiteOS/targets/Kconfig.hq
```kconfig
config LOSCFG_PLATFORM
    string
    default "npu_v100"           if LOSCFG_PLATFORM_NPU_V100_BBK
    default "npu_v200"           if LOSCFG_PLATFORM_NPU_V200_BE
    default "npu_v200"           if LOSCFG_PLATFORM_NPU_V200_CE || LOSCFG_PLATFORM_NPU_V200_CE_ES
    default "npu_v200"           if LOSCFG_PLATFORM_NPU_V200_LN
    default "npu_v200"           if LOSCFG_PLATFORM_NPU_V200_CPRO
    default "npu_v200"           if LOSCFG_PLATFORM_NPU_V200_NSV
    default "audiodsp_hifi3z"    if LOSCFG_PLATFORM_AUDIODSP_HIFI3Z
    default "audiodsp_hifi3z"    if LOSCFG_PLATFORM_AUDIODSP_HIFI3Z_EMU
    default "audiodsp_linglong"  if LOSCFG_PLATFORM_AUDIODSP_LINGLONG
    default "audiodsp_linglong"  if LOSCFG_PLATFORM_AUDIODSP_LINGLONG_BVP
    default "isp"                if LOSCFG_PLATFORM_ISP_V320
    default "isp"                if LOSCFG_PLATFORM_ISP_V350
    default "isp"                if LOSCFG_PLATFORM_ISP_V360
    default "isp"                if LOSCFG_PLATFORM_ISP_V130
    default "isp"                if LOSCFG_PLATFORM_ISP_V210
    default "isp_lx"             if LOSCFG_PLATFORM_ISP_V500
    default "oisp_lx"            if LOSCFG_PLATFORM_OISP_V100
    default "sensor_a6"          if LOSCFG_PLATFORM_SENSOR_A6
    default "sensorhub_arm"      if LOSCFG_PLATFORM_SH_CE || LOSCFG_PLATFORM_SH_BBK
    default "sensorhub_arm"      if LOSCFG_PLATFORM_SH_AN
    default "sensorhub_lx"       if LOSCFG_PLATFORM_SH_CPRO || LOSCFG_PLATFORM_SH_NSV
    default "sensorhub_se_lx"    if LOSCFG_PLATFORM_SH_SE_NSV
    default "lpm_v200"           if LOSCFG_PLATFORM_LPM_CE
    default "lpm_v200"           if LOSCFG_PLATFORM_LPM_CPRO
    default "lpm_v200"           if LOSCFG_PLATFORM_LPM_BBK
    default "ivp"                if LOSCFG_PLATFORM_IVP_BBK
    default "vdec"               if LOSCFG_PLATFORM_VDEC_NSV

config LOSCFG_ISP_R8_COMMON
    bool
    select LOSCFG_ARCH_CORTEX_R8
    select LOSCFG_ARM_GIC_V2
    select LOSCFG_DRIVERS_UART_LITEOS
    select LOSCFG_USING_BOARD_LD

choice
    prompt "Board"
    depends on LOSCFG_FAMILY_HQ
    default LOSCFG_PLATFORM_NPU_V200_BE

config LOSCFG_PLATFORM_NPU_V100_BBK
    bool "npu_v100_bbk"
    select LOSCFG_ARCH_CORTEX_A53
    select LOSCFG_ARM_GIC_V3
    select LOSCFG_ARM_GENERIC_TIMER
    select LOSCFG_DRIVERS_UART_ARM_PL011
    select LOSCFG_DRIVERS_UART_LITEOS
    select LOSCFG_USING_BOARD_LD

config LOSCFG_PLATFORM_NPU_V200_BE
    bool "npu_v200_be"
    select LOSCFG_ARCH_LINXCORE_131
    select LOSCFG_ARM_SP804_TIMER
    select LOSCFG_DRIVERS_UART_VENDOR
    select LOSCFG_USING_BOARD_LD

config LOSCFG_PLATFORM_NPU_V200_CE
    bool "npu_v200_ce"
    select LOSCFG_ARCH_LINXCORE_131
    select LOSCFG_RISCV_HQTIMER_V500
    select LOSCFG_DRIVERS_UART_VENDOR
    select LOSCFG_USING_BOARD_LD

config LOSCFG_PLATFORM_NPU_V200_CE_ES
    bool "npu_v200_ce_es"
    select LOSCFG_ARCH_LINXCORE_131
    select LOSCFG_RISCV_HQTIMER_V500
    select LOSCFG_DRIVERS_UART_VENDOR
    select LOSCFG_USING_BOARD_LD

config LOSCFG_PLATFORM_NPU_V200_NSV
    bool "npu_v200_nsv"
    select LOSCFG_ARCH_LINXCORE_131
    select LOSCFG_RISCV_HQTIMER_V510
    select LOSCFG_DRIVERS_UART_VENDOR
    select LOSCFG_USING_BOARD_LD

config LOSCFG_PLATFORM_NPU_V200_LN
    bool "npu_v200_ln"
    select LOSCFG_ARCH_LINXCORE_131
    select LOSCFG_RISCV_HQTIMER_V500
    select LOSCFG_DRIVERS_UART_VENDOR
    select LOSCFG_USING_BOARD_LD

config LOSCFG_PLATFORM_NPU_V200_CPRO
    bool "npu_v200_cpro"
    select LOSCFG_ARCH_LINXCORE_131
    select LOSCFG_RISCV_HQTIMER_V510
    select LOSCFG_DRIVERS_UART_VENDOR
    select LOSCFG_USING_BOARD_LD

config LOSCFG_PLATFORM_AUDIODSP_HIFI3Z
    bool "audiodsp_hifi3z"
    select LOSCFG_USING_BOARD_LD
    select LOSCFG_XTENSA_HIFI3Z
    select LOSCFG_XTENSA_XEA2_TIMER if LOSCFG_TEST
    select LOSCFG_TIMER_VENDOR if !LOSCFG_TEST
    select LOSCFG_XEA2_INT_CONTROLLER
    select LOSCFG_DRIVERS_UART_VENDOR

config LOSCFG_PLATFORM_AUDIODSP_HIFI3Z_EMU
    bool "audiodsp_hifi3z_emu"
    select LOSCFG_USING_BOARD_LD
    select LOSCFG_XTENSA_HIFI3Z
    select LOSCFG_XTENSA_XEA2_TIMER
    select LOSCFG_XEA2_INT_CONTROLLER
    select LOSCFG_DRIVERS_UART_VENDOR

config LOSCFG_PLATFORM_ISP_V320
    bool "isp_v320"
    select LOSCFG_ISP_R8_COMMON
    select LOSCFG_ARM_PRIVATE_TIMER
    select LOSCFG_DRIVERS_UART_HQ_UART_V500

config LOSCFG_PLATFORM_ISP_V350
    bool "isp_v350"
    select LOSCFG_ISP_R8_COMMON
    select LOSCFG_ARM_PRIVATE_TIMER
    select LOSCFG_DRIVERS_UART_HQ_UART_V500

config LOSCFG_PLATFORM_ISP_V360
    bool "isp_v360"
    select LOSCFG_ISP_R8_COMMON
    select LOSCFG_ARM_PRIVATE_TIMER
    select LOSCFG_DRIVERS_UART_HQ_UART_V500

config LOSCFG_PLATFORM_ISP_V130
    bool "isp_v130"
    select LOSCFG_ISP_R8_COMMON
    select LOSCFG_RISCV_HQTIMER_V500
    select LOSCFG_DRIVERS_UART_HQ_UART_V501

config LOSCFG_PLATFORM_ISP_V210
    bool "isp_v210"
    select LOSCFG_ISP_R8_COMMON
    select LOSCFG_ARM_SP804_TIMER
    select LOSCFG_DRIVERS_UART_HQ_UART_V200

config LOSCFG_PLATFORM_ISP_V500
    bool "isp_v500"
    select LOSCFG_ARCH_LINXCORE_610
    select LOSCFG_ARCH_ARM_AARCH64_LSE_ATOMIC
    select LOSCFG_ARM_GIC_V3
    select LOSCFG_DRIVERS_UART_LITEOS
    select LOSCFG_USING_BOARD_LD

config LOSCFG_PLATFORM_OISP_V100
    bool "oisp_v100"
    select LOSCFG_ARCH_LINXCORE_170_CONFIG32
    select LOSCFG_RISCV_HQTIMER_V510
    select LOSCFG_DRIVERS_UART_VUART_RPQ
    select LOSCFG_DRIVERS_UART_LITEOS
    select LOSCFG_USING_BOARD_LD

config LOSCFG_PLATFORM_SENSOR_A6
    bool "sensor_a6"
    select LOSCFG_ARCH_LINXCORE_132
    select LOSCFG_RISCV_HQTIMER_V510
    select LOSCFG_DRIVERS_UART_LITEOS
    select LOSCFG_DRIVERS_UART_HQ_UART_V500
    select LOSCFG_USING_BOARD_LD

config LOSCFG_PLATFORM_AUDIODSP_LINGLONG
    bool "audiodsp_linglong"
    select LOSCFG_ARCH_LINGLONG
    select LOSCFG_USING_BOARD_LD
    select LOSCFG_LINGLONG_IC
    select LOSCFG_DRIVERS_UART_VENDOR

config LOSCFG_PLATFORM_AUDIODSP_LINGLONG_BVP
    bool "audiodsp_linglong bvp"
    select LOSCFG_ARCH_LINGLONG
    select LOSCFG_USING_BOARD_LD
    select LOSCFG_LINGLONG_IC
    select LOSCFG_TIMER_VENDOR
    select LOSCFG_DRIVERS_UART_VENDOR

config LOSCFG_PLATFORM_SH_CE
    bool "sensorhub_ce"
    select LOSCFG_ARCH_CORTEX_M7
    select LOSCFG_ARCH_FPU_VFP_DP
    select LOSCFG_INTERRUPT_VENDOR
    select LOSCFG_TIMER_VENDOR
    select LOSCFG_DRIVERS_UART_VENDOR
    select LOSCFG_USING_BOARD_LD

config LOSCFG_PLATFORM_SH_BBK
    bool "sensorhub_bbk"
    select LOSCFG_ARCH_CORTEX_M7
    select LOSCFG_ARCH_FPU_VFP_DP
    select LOSCFG_INTERRUPT_VENDOR
    select LOSCFG_TIMER_VENDOR
    select LOSCFG_DRIVERS_UART_VENDOR
    select LOSCFG_USING_BOARD_LD

config LOSCFG_PLATFORM_SH_AN
    bool "sensorhub_an"
    select LOSCFG_ARCH_CORTEX_M55
    select LOSCFG_ARCH_FPU_VFP_DP
    select LOSCFG_INTERRUPT_VENDOR
    select LOSCFG_TIMER_VENDOR
    select LOSCFG_DRIVERS_UART_VENDOR
    select LOSCFG_USING_BOARD_LD

config LOSCFG_PLATFORM_SH_CPRO
    bool "sensorhub_cpro"
    select LOSCFG_ARCH_LINXCORE_170_CONFIG41
    select LOSCFG_TIMER_VENDOR
    select LOSCFG_DRIVERS_UART_VENDOR
    select LOSCFG_USING_BOARD_LD

config LOSCFG_PLATFORM_SH_SE_NSV
    bool "sensorhub_se_nsv"
    select LOSCFG_ARCH_LINXCORE_170_CONFIG61
    select LOSCFG_TIMER_VENDOR
    select LOSCFG_DRIVERS_UART_VENDOR
    select LOSCFG_USING_BOARD_LD
    select LOSCFG_USING_BOARD_RESET_VECTOR
    select LOSCFG_SAFETY_KERNEL
    select LOSCFG_DRVBOX_PRIV_MODE

config LOSCFG_PLATFORM_SH_NSV
    bool "sensorhub_nsv"
    select LOSCFG_ARCH_LINXCORE_170_CONFIG61
    select LOSCFG_TIMER_VENDOR
    select LOSCFG_DRIVERS_UART_VENDOR
    select LOSCFG_USING_BOARD_LD

config LOSCFG_PLATFORM_LPM_CE
    bool "lpm_v200_ce"
    select LOSCFG_INTERRUPT_VENDOR
    select LOSCFG_ARCH_LINXCORE_131
    select LOSCFG_TIMER_VENDOR
    select LOSCFG_DRIVERS_UART_VENDOR
    select LOSCFG_USING_BOARD_LD
    select LOSCFG_USING_BOARD_RESET_VECTOR

config LOSCFG_PLATFORM_LPM_CPRO
    bool "lpm_v200_cpro"
    select LOSCFG_INTERRUPT_VENDOR
    select LOSCFG_ARCH_LINXCORE_131
    select LOSCFG_TIMER_VENDOR
    select LOSCFG_DRIVERS_UART_VENDOR
    select LOSCFG_USING_BOARD_LD
    select LOSCFG_USING_BOARD_RESET_VECTOR

config LOSCFG_PLATFORM_LPM_BBK
    bool "lpm_v200_bbk"
    select LOSCFG_INTERRUPT_VENDOR
    select LOSCFG_ARCH_CORTEX_M3
    select LOSCFG_TIMER_VENDOR
    select LOSCFG_DRIVERS_UART_VENDOR
    select LOSCFG_USING_BOARD_LD
    select LOSCFG_USING_BOARD_RESET_VECTOR

config LOSCFG_PLATFORM_IVP_BBK
    bool "ivp_bbk"
    select LOSCFG_XTENSA_XEA3_TIMER if LOSCFG_TEST
    select LOSCFG_TIMER_VENDOR if !LOSCFG_TEST
    select LOSCFG_XEA3_INT_CONTROLLER
    select LOSCFG_DRIVERS_UART_VENDOR
    select LOSCFG_USING_BOARD_RESET_VECTOR
    select LOSCFG_XTENSA_VISIONQ6_V2
    select LOSCFG_USING_BOARD_LD

config LOSCFG_PLATFORM_VDEC_NSV
    bool "vdec_nsv"
    select LOSCFG_ARCH_LINXCORE_170_CONFIG32
    select LOSCFG_RISCV_HQTIMER_V510
    select LOSCFG_DRIVERS_UART_HQ_UART_V500
    select LOSCFG_USING_BOARD_LD
    select LOSCFG_USING_BOARD_RESET_VECTOR

endchoice
```
